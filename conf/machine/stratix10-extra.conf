## conf/machine/stratix10-extra.conf
```bitbake
#@TYPE: Machine
#@NAME: stratix10
#@DESCRIPTION: Machine configuration for the Stratix 10 SoC"

PREFERRED_PROVIDER_virtual/bootloader = "u-boot-socfpga"
PREFERRED_VERSION_u-boot-socfpga = "v2022.04-stratix10+git"

UBOOT_EXTLINUX = "0"
UBOOT_CONFIG = "stratix10-socdk-dnx"
UBOOT_CONFIG[stratix10-socdk-dnx] = "socfpga_stratix10_tes_defconfig"
UBOOT_BINARY = "u-boot.img"
UBOOT_SUFFIX = "img"

EVALKIT ?= "dnx"
EVALKIT:tesdavenx ?= "dnx"

IMAGE_BOOT_FILES = " \
	${KERNEL_IMAGETYPE} \
	${UBOOT_BINARY} \
	socfpga_stratix10_socdk_dnx.dtb \
	u-boot.scr \
"

KERNEL_DEVICETREE = " \
        altera/socfpga_stratix10_socdk_dnx.dtb \
"
```
