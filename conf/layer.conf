## conf/layer.conf
```bitbake
# We have a conf and classes directory, add to BBPATH
BBPATH .= ":${LAYERDIR}"

# We have recipes-* directories, add to BBFILES
BBFILES += "${LAYERDIR}/recipes-*/*/*.bb ${LAYERDIR}/recipes-*/*/*.bbappend"

BBFILE_COLLECTIONS += "tes"
BBFILE_PATTERN_tes = "^${LAYERDIR}/"
BBFILE_PRIORITY_tes = "8"

LAYERSERIES_COMPAT_tes = "nanbield"

PREFERRED_PROVIDER_virtual/egl = "davenx"
PREFERRED_PROVIDER_virtual/libgles2 = "davenx"

# We are incompatible to the MESA package, thus remove the distro features
# that bring MESA dependencies into our image.
# Furthermore, we do not support vulkan.
DISTRO_FEATURES:remove = "x11 wayland opengl vulkan"

TES_SRC = "${LAYERDIR}/src"
TES_BIN = "${LAYERDIR}/bin"

TES_SVN_PATH ?= "svn://svn.hamburg.tes/svn/tes_davenx/devel"
TES_D2D_SVN_PATH ?= "svn://svn.hamburg.tes/svn/tes_dave2d/devel"
TES_TOOLS_SVN_PATH ?= "svn://svn.hamburg.tes/svn/tes_tools"

UBOOT_W_CONFIG[doc] = "Configures the UBOOT_W_MACHINE and can also define IMAGE_FSTYPES for individual cases."

IMAGE_FSTYPES = "wic.xz"

# We don't want a SDK_VERSION in the file name. This would break some of the
# EvalKit generation scripts.
TOOLCHAIN_OUTPUTNAME = "${SDK_NAME}-toolchain"

# todo: use generic way to include the *-extra files
require conf/machine/agilex5-extra.conf
```

## conf/machine/agilex5-extra.conf
```bitbake
#@TYPE: Machine
#@NAME: agilex5
#@DESCRIPTION: Machine configuration for the Agilex 5 SoC"

PREFERRED_VERSION_u-boot-socfpga = "v2023.10%"

UBOOT_CONFIG = "arrow-axe5-eagle"
UBOOT_CONFIG[arrow-axe5-eagle] = "socfpga_agilex5_axe5_eagle_defconfig"

UBOOT_EXTLINUX ?= "1"
UBOOT_EXTLINUX_LABELS ?= "default"
UBOOT_EXTLINUX_DEFAULT_LABEL ?= "Arrow AXE5-Eagle SDMMC"

UBOOT_EXTLINUX_MENU_DESCRIPTION:default ?= "Arrow AXE5-Eagle SDMMC"
UBOOT_EXTLINUX_KERNEL_IMAGE:default ?= "../${KERNEL_IMAGETYPE}"
UBOOT_EXTLINUX_FDT:default ?= "../socfpga_agilex5_axe5_eagle_dnx.dtb"
UBOOT_EXTLINUX_CONSOLE ?= "console=ttyS0,115200n8"
UBOOT_EXTLINUX_KERNEL_ARGS:default ?= "rootwait rw earlyprintk"
UBOOT_EXTLINUX_ROOT:default ?= "root=/dev/mmcblk0p2"

EVALKIT ?= "dnx"
EVALKIT:tesdavenx ?= "dnx"

UBOOT_ITB = "u-boot.itb"
IMAGE_BOOT_FILES = " \
	${KERNEL_IMAGETYPE} ${UBOOT_ITB} \
	socfpga_agilex5_axe5_eagle_dnx.dtb \
	extlinux.conf;extlinux/extlinux.conf \
"

KERNEL_DEVICETREE = " \
        arrow/socfpga_agilex5_axe5_eagle_dnx.dtb \
"
```

## conf/machine/arria10-extra.conf
```bitbake
#@TYPE: Machine
#@NAME: arria10
#@DESCRIPTION: Machine configuration for the Arria 10 SoC"

PREFERRED_VERSION_u-boot-socfpga-tes = "v2023.10%"

UBOOT_CONFIG = "dreamchip-arria10som"
UBOOT_CONFIG[dreamchip-arria10som] = "socfpga_dreamchip_som_defconfig"

# extlinux
UBOOT_EXTLINUX ?= "1"

UBOOT_EXTLINUX_LABELS ?= "cmdline"
UBOOT_EXTLINUX_LABELS:append:tesdemo = " demo"
UBOOT_EXTLINUX_DEFAULT_LABEL ?= "Command Line"
UBOOT_EXTLINUX_DEFAULT_LABEL:tesdemo ?= "Demo Mode"
UBOOT_EXTLINUX_TIMEOUT ?= "10"

UBOOT_EXTLINUX_CONSOLE ?= "console=ttyS0,115200n8"

UBOOT_EXTLINUX_KERNEL_IMAGE ?= "../${KERNEL_IMAGETYPE}"
UBOOT_EXTLINUX_FDT ?= "../dreamchip_arria10som_tes.dtb"
UBOOT_EXTLINUX_ROOT ?= "root=/dev/mmcblk0p2"

UBOOT_EXTLINUX_MENU_DESCRIPTION:demo ?= "Demo Mode"
UBOOT_EXTLINUX_KERNEL_ARGS:demo ?= "rootwait rw earlyprintk vmalloc=768M 5"

UBOOT_EXTLINUX_MENU_DESCRIPTION:cmdline ?= "Command Line"
UBOOT_EXTLINUX_KERNEL_ARGS:cmdline ?= "rootwait rw earlyprintk vmalloc=768M 3"

EVALKIT ?= "dnx"
EVALKIT:tesdavenx ?= "dnx"

UBOOT_ITB = "fit_spl_fpga.itb"
IMAGE_BOOT_FILES = " \
	${KERNEL_IMAGETYPE} \
	${UBOOT_BINARY} \
	${UBOOT_ITB} \
	${KERNEL_DEVICETREE} \
	extlinux.conf;extlinux/extlinux.conf \
"

KERNEL_DEVICETREE = " \
        dreamchip_arria10som_tes.dtb \
"
```

## conf/machine/cyclone5-extra.conf
```bitbake
#@TYPE: Machine
#@NAME: cyclone5
#@DESCRIPTION: Machine configuration for the Cyclone 5 SoC"

PREFERRED_VERSION_u-boot-socfpga = "v2023.10%"

UBOOT_CONFIG = "cyclone5-de0"
UBOOT_CONFIG:de10 = "de10-nano-soc"

# Do not use EXTLINUX
UBOOT_EXTLINUX ?= "0"

EVALKIT ?= "dhd"
EVALKIT:dave2d = "d2d"
EVALKIT:davehd = "dhd"
EVALKIT:tescdc = "cdc"

UBOOT_RBF_FILES:append:dave2d = "\
socfpga_cyclone5_de10_nano_d2d.rbf \
"

UBOOT_RBF_FILES:append:davehd = "\
socfpga_cyclone5_de10_nano_dhd.rbf \
"
UBOOT_RBF_FILES:append:tescdc = "\
socfpga_cyclone5_de10_nano_cdc.rbf \
"

UBOOT_RBF_FILES:append:tescdc = "\
socfpga_cyclone5_de10_nano_cdc.rbf \
"

IMAGE_BOOT_FILES = "${UBOOT_RBF_FILES}"

KERNEL_DEVICETREE = " \
        socfpga_cyclone5_de10_sockit_d2d.dtb \
        socfpga_cyclone5_de10_sockit_dhd.dtb \
        socfpga_cyclone5_de10_sockit_cdc.dtb \
        socfpga_cyclone5_de10_sockit_tes_lcd.dtb \
"
```

## recipes-bsp/u-boot/files/arria10/socdk/fit_spl_socdk.its
```
// SPDX-License-Identifier: GPL-2.0
 /*
 * Copyright (C) 2019 Intel Corporation <www.intel.com>
 *
 */

/dts-v1/;

/ {
	description = "FIT image with FPGA bistream";
	#address-cells = <1>;

	images {
		fpga-periph-1 {
			description = "FPGA full bitstream";
			data = /incbin/("socfpga_arria10_socdk_tes.rbf");
			type = "fpga";
			arch = "arm";
			compression = "none";
		};
	};

	configurations {
		default = "config-1";
		config-1 {
			description = "Boot with full config";
			fpga = "fpga-periph-1";
		};
	};
};
```

## wic/sdimage-tes-arria10-socdk.wks
```
# short-description: Create an SD card image for the Arria 10 SoC TES EvalKit.
# long-description: Create an SD card image for the Arria 10 SoC TES EvalKit.
# Boot files are located in the first vfat partition and u-Boot is located in
# the third partition.

part --source bootimg-partition --ondisk mmcblk --fstype=vfat --label boot --active --align 1024 --size 50M
part / --source rootfs --ondisk mmcblk --fstype=ext4 --label root --align 4 --size 1024
part --source rawcopy --sourceparams="file=u-boot-with-spl.sfp-arria10-arria10-socdk" --ondisk mmcblk --system-id=a2 --align 4 --fixed-size 10M
```

## wic/sdimage-tes-cyclone5-de10-nano.wks
```
# short-description: Create an SD card image for the Cyclone 5 DE10 Nano TES IP EvalKit.
# long-description: Create an SD card image for the Cyclone 5 DE10 Nano TES IP EvalKit.
# Boot files are located in the first vfat partition and u-Boot is located in
# the second partition.

part --source bootimg-partition --ondisk mmcblk --fstype=vfat --label boot --active --align 4 --size 32
part --source rawcopy --sourceparams="file=u-boot-with-spl.sfp" --ondisk mmcblk --system-id=a2 --align 4 --fixed-size 1M
part / --source rootfs --ondisk mmcblk --fstype=ext4 --label root --align 4 --size 1024
```

## wic/sdimage-tes-dreamchip-arria10som.wks
```
# short-description: Create an SD card image for the Dreamchip Arria 10 SoM TES EvalKit.
# long-description: Create an SD card image for the Dreamchip Arria 10 SoM TES EvalKit.
# Boot files are located in the first vfat partition and u-Boot is located in
# the second partition.

part --source bootimg-partition --ondisk mmcblk --fstype=vfat --mkfs-extraopts "-F 32" --label boot --active --align 1024 --fixed-size 500M --system-id b
part --source rawcopy --sourceparams="file=u-boot-with-spl.sfp-arria10-dreamchip-arria10som" --ondisk mmcblk --system-id=a2 --align 4 --fixed-size 10M
part / --source rootfs --ondisk mmcblk --fstype=ext4 --label root --align 4 --size 1024
```

## wic/sdimage-tes-stratix10-socdk.wks
```
# short-description: Create an SD card image for the Arria 10 SoC TES EvalKit.
# long-description: Create an SD card image for the Arria 10 SoC TES EvalKit.
# Boot files are located in the first vfat partition and u-Boot is located in
# the third partition.

part --source bootimg-partition --ondisk mmcblk --fstype=vfat --label boot --active --align 1024 --size 50M
#part / --source rootfs --ondisk mmcblk --fstype=ext4 --label root --align 4 --size 1024
```
